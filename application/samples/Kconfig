## application/samples/Kconfig
```kconfig
#===============================================================================
# @brief    Kconfig file.
# Copyright (c) HiSilicon (Shanghai) Technologies Co., Ltd. 2023-2023. All rights reserved.
#===============================================================================

config ENABLE_BT_SAMPLE
    bool
    prompt "Enable the Sample of BT."
    default n
    depends on SAMPLE_ENABLE
    help
        This option means enable the sample of BT.

if ENABLE_BT_SAMPLE
osource "application/samples/bt/Kconfig"
endif

config ENABLE_PERIPHERAL_SAMPLE
    bool
    prompt "Enable the Sample of peripheral."
    default n
    depends on SAMPLE_ENABLE
    help
        This option means enable the sample of peripheral.

if ENABLE_PERIPHERAL_SAMPLE
osource "application/samples/peripheral/Kconfig"
endif

config ENABLE_WIFI_SAMPLE
    bool
    prompt "Enable the Sample of WIFI."
    default n
    depends on SAMPLE_ENABLE
    help
        This option means enable the sample of WIFI.

if ENABLE_WIFI_SAMPLE
osource "application/samples/wifi/Kconfig"
endif

config ENABLE_RADAR_SAMPLE
    bool
    prompt "Enable the Sample of RADAR."
    default n
    depends on SAMPLE_ENABLE
    help
        This option means enable the sample of RADAR.

if ENABLE_RADAR_SAMPLE
osource "application/samples/radar/Kconfig"
endif

config ENABLE_DEMO_SAMPLE
    bool
    prompt "Enable the Sample of DEMO."
    default n
    depends on SAMPLE_ENABLE
    help
        This option means enable the sample of DEMO.

if ENABLE_DEMO_SAMPLE
osource "application/samples/demo/Kconfig"
endif

config ENABLE_MYDEMO_SAMPLE
    bool
    prompt "Enable the Sample of MYDEMO."
    default n
    depends on SAMPLE_ENABLE
    help
        This option means enable the sample of MYDEMO.

if ENABLE_MYDEMO_SAMPLE
osource "application/samples/mydemo/Kconfig"
endif
```

## application/samples/demo/Kconfig
```kconfig
#===============================================================================
# @brief    Kconfig file.
# Copyright (c) HiSilicon (Shanghai) Technologies Co., Ltd. 2023-2023. All rights reserved.
#===============================================================================
config ENABLE_ALL_DEMO_SAMPLE
    bool
    prompt "Enable all the sample of demo, it's just for build."
    default n
    depends on ENABLE_DEMO_SAMPLE
    select SAMPLE_SUPPORT_LED
    help
        This option means enable all the sample of demo, it is just for build.

config SAMPLE_SUPPORT_LED
    bool
    prompt "Support LED Sample."
    default n
    depends on ENABLE_DEMO_SAMPLE
    help
        This option means support LED Sample.

if SAMPLE_SUPPORT_LED
menu "LED Sample Configuration"
    osource "application/samples/demo/led/Kconfig"
endmenu
endif
```

## application/samples/mydemo/Kconfig
```kconfig
#===============================================================================
# @brief    Kconfig file.
# Copyright (c) HiSilicon (Shanghai) Technologies Co., Ltd. 2023-2023. All rights reserved.
#===============================================================================
config ENABLE_ALL_MYDEMO_SAMPLE
    bool
    prompt "Enable all the sample of mydemo, it's just for build."
    default n
    depends on ENABLE_MYDEMO_SAMPLE
    select SAMPLE_SUPPORT_FOC
    select SAMPLE_SUPPORT_LFS
    help
        This option means enable all the sample of demo, it is just for build.

config SAMPLE_SUPPORT_FOC
    bool
    prompt "Support FOC Sample."
    default n
    depends on ENABLE_MYDEMO_SAMPLE
    help
        This option means support FOC Sample.

if SAMPLE_SUPPORT_FOC
menu "FOC Sample Configuration"
    osource "application/samples/mydemo/foc/Kconfig"
endmenu
endif

config SAMPLE_SUPPORT_LFS
    bool
    prompt "Support LFS Sample."
    default n
    depends on ENABLE_MYDEMO_SAMPLE
    help
        This option means support LFS Sample.

if SAMPLE_SUPPORT_FOC
menu "LFS Sample Configuration"
    osource "application/samples/mydemo/lfs/Kconfig"
endmenu
endif
```
